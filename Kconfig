## Kconfig
```kconfig
# SPDX-License-Identifier: MIT

config ZMK_ADV360_STATUS_LEDS
    bool "Kinesis Adv360 status LEDs"
    default y
    depends on DT_HAS_KINESIS_ADV360_STATUS_LEDS_ENABLED
    select LED_STRIP
    select ZMK_EXT_POWER
    select ZMK_BATTERY_REPORTING
    select ZMK_HID_INDICATORS

if ZMK_ADV360_STATUS_LEDS

config ZMK_ADV360_STATUS_LEDS_ON_START
    bool "Turn Adv360 status LEDs on at startup"
    default y

config ZMK_ADV360_STATUS_LEDS_BRIGHTNESS
    int "Adv360 status LED brightness in percent"
    range 1 100
    default 20

endif # ZMK_ADV360_STATUS_LEDS
```

## boards/kinesis/adv360/board.yml
```yaml
boards:
  - name: adv360_left
    vendor: kinesis
    socs:
      - name: nrf52840
        variants:
          - name: zmk
  - name: adv360_right
    vendor: kinesis
    socs:
      - name: nrf52840
        variants:
          - name: zmk
```

## config/west.yml
```yaml
manifest:
  remotes:
    - name: zmkfirmware
      url-base: https://github.com/zmkfirmware
  projects:
    - name: zmk
      remote: zmkfirmware
      revision: cb615aee9a7c427e251f2ab62080c1a44a165da9
      import: app/west.yml
  self:
    path: config
```

## dts/bindings/behaviors/kinesis,behavior-adv360-status-tap.yaml
```yaml
# Copyright (c) 2026 The ZMK Contributors
# SPDX-License-Identifier: MIT

description: Kinesis Adv360 status LED behavior

compatible: "kinesis,behavior-adv360-status-tap"

include: one_param.yaml
```

## dts/bindings/kinesis,adv360-status-leds.yaml
```yaml
# Copyright (c) 2026 The ZMK Contributors
# SPDX-License-Identifier: MIT

description: Kinesis Adv360 RGB status LED strip controller

compatible: "kinesis,adv360-status-leds"

properties:
  led-strip:
    type: phandle
    required: true
    description: WS2812 LED strip device used for the three Adv360 status LEDs
```
